## boards/arm/inplaydk_in612le/Kconfig.board
```kconfig
# Copyright (c) 2023 InPlay Inc.
# SPDX-License-Identifier: Apache-2.0

config BOARD_INPLAYDK_IN612LE
	bool "InPlay DK 612LE"
	depends on SOC_IN6XXE
```

## boards/arm/inplaydk_in612le/Kconfig.defconfig
```kconfig
# Copyright (c) 2023 InPlay Inc.
# SPDX-License-Identifier: Apache-2.0

if BOARD_INPLAYDK_IN612LE

config BOARD
	default "inplaydk_612le" 

endif # BOARD_INPLAYDK_IN612LE

choice BT_HCI_BUS_TYPE
    default BT_IN6XX if BT
endchoice

config BT_HCI_ACL_FLOW_CONTROL
	default n if BT
```

## boards/arm/inplaydk_in612le/inplaydk_in612le_defconfig
```kconfig
# SPDX-License-Identifier: Apache-2.0

CONFIG_SOC_SERIES_IN6XXE=y
CONFIG_SOC_IN6XXE=y
CONFIG_BOARD_INPLAYDK_IN612LE=y
CONFIG_SYS_CLOCK_TICKS_PER_SEC=1000

# Enable MPU
#CONFIG_ARM_MPU=y

# Enable hardware stack protection
#CONFIG_HW_STACK_PROTECTION=y

# Enable RTT
#CONFIG_USE_SEGGER_RTT=y

# enable GPIO
CONFIG_GPIO=y
CONFIG_PINCTRL=y
# enable uart driver
CONFIG_SERIAL=y

CONFIG_CONSOLE=y
CONFIG_UART_CONSOLE=y
CONFIG_STDOUT_CONSOLE=y

CONFIG_DYNAMIC_INTERRUPTS=y
CONFIG_MAIN_STACK_SIZE=4096

#enable PM
#CONFIG_PM=y
#CONFIG_PM_POLICY_CUSTOM=y
#CONFIG_TIMER_READS_ITS_FREQUENCY_AT_RUNTIME=y

#CONFIG_EVENTS=y
# enable console
#CONFIG_CONSOLE=y
#CONFIG_UART_CONSOLE=y
#CONFIG_LOG_MODE_IMMEDIATE=y
#CONFIG_BT_RECV_BLOCKING=y
```

## drivers/counter/Kconfig.in6xxe_aon_tmr
```kconfig
# IN6XXE AON counter timer configuration options

# Copyright (c) 2023 Inplay Inc.
# SPDX-License-Identifier: Apache-2.0

config COUNTER_AON_TIMER_IN6XXE
	bool "IN6XXE AON timer counter driver"
	default y
	depends on DT_HAS_INPLAY_IN6XXE_AON_TMR_ENABLED && SOC_FAMILY_INPLAY
	help
	  Enable AON counter timer driver for IN6XXE series devices.
```

## drivers/counter/Kconfig.in6xxe_tmr
```kconfig
# IN6XXE counter timer configuration options

# Copyright (c) 2023 Inplay Inc.
# SPDX-License-Identifier: Apache-2.0

config COUNTER_TIMER_IN6XXE
	bool "IN6XXE PD1 timer counter driver"
	default y
	depends on DT_HAS_INPLAY_IN6XXE_TMR_ENABLED && SOC_SERIES_INPLAY
	help
	  Enable counter timer driver for IN6XXE series devices.
```

## drivers/flash/Kconfig.in6xxe
```kconfig
# Copyright (c) 2023 InPlay Inc
# SPDX-License-Identifier: Apache-2.0

config SOC_FLASH_IN6XXE
	bool "InPlay IN6XXE flash driver"
	default y
	depends on DT_HAS_INPLAY_IN6XXE_FLASH_CONTROLLER_ENABLED
	select FLASH_HAS_DRIVER_ENABLED
	select FLASH_HAS_PAGE_LAYOUT
	help
	  Enable IN6XXE internal flash driver.
```

## drivers/gpio/Kconfig.in6xxe
```kconfig
# Copyright (c) 2023 InPlay Inc.
# SPDX-License-Identifier: Apache-2.0

config GPIO_IN6XXE
	bool "IN6XXE GPIO driver"
	default y
	depends on DT_HAS_INPLAY_IN6XXE_GPIO_ENABLED
	help
	  Enable the IN6XXE GPIO driver.
```

## drivers/pinctrl/Kconfig.in6xxe
```kconfig
# Copyright (c) 2023 InPlay Inc.
# SPDX-License-Identifier: Apache-2.0

config PINCTRL_IN6XXE
	bool "INPLAY pin controller driver"
	default y
	depends on DT_HAS_INPLAY_IN6XXE_PINCTRL_ENABLED
	help
	  INPLAY  pin controller driver. This driver is used by series using the
	  pin multiplexing model.
```

## drivers/serial/Kconfig.in6xxe
```kconfig
# InPlay UART configuration options

# Copyright (c) 2023 InPlay Inc.
# SPDX-License-Identifier: Apache-2.0

config UART_IN6XXE
	bool "InPlay IN6XXE UART driver"
	default y
	depends on DT_HAS_INPLAY_IN6XXE_UART_ENABLED
	select SERIAL_HAS_DRIVER
	help
	  This option enables the UART driver for INI6XXE.
```

## drivers/timer/Kconfig.in6xxe_sys
```kconfig
# Copyright (c) 2023 Inplay Inc.
# SPDX-License-Identifier: Apache-2.0

config IN6XXE_SYS_TIMER
	bool "Inplay IN6XXE always on system clock timer"
	default y
	depends on PM
	depends on SOC_FAMILY_INPLAY
	select TICKLESS_CAPABLE
	help
	  This module implements a kernel device driver for the IN6XXE AON Timer and
	  provides the standard "system clock driver" interfaces.
```

## dts/bindings/counter/inplay,in6xxe-aon-tmr.yaml
```yaml
# Copyright (c) 2023, Inplay Inc.
# SPDX-License-Identifier: Apache-2.0

description: IN6XXE AON timers

compatible: "inplay,in6xxe-aon-tmr"

include: base.yaml

properties:
  index:
    required: true
    type: int
    enum:
      - 0
      - 1
      - 2
      - 3
    description: Index of IN6XXE AON timers.

  channel-num:
    type: int
    default: 0
    description: Alarm channel count the timer supports, only AON timer2 has two emit signals.

  is-64bit:
    type: boolean
    description: If the timer is 64bit
```

## dts/bindings/counter/inplay,in6xxe-tmr.yaml
```yaml
# Copyright (c) 2021, Kent Hall
# SPDX-License-Identifier: Apache-2.0

description: IN6XXE PD1 timers

compatible: "inplay,in6xxe-tmr"

include: base.yaml
```

## dts/bindings/flash_controller/inplay,in6xxe-flash-controller.yaml
```yaml
# Copyright (c) 2023 InPlay Inc
# SPDX-License-Identifier: Apache-2.0

description: |
  IN6XXE flash

compatible: "inplay,in6xxe-flash-controller"

include: flash-controller.yaml
```

## dts/bindings/gpio/inplay,in6xxe-gpio.yaml
```yaml
# Copyright (c) 2023 InPlay Inc.
# SPDX-License-Identifier: Apache-2.0

description: IN6XXE GPIO node

compatible: "inplay,in6xxe-gpio"

include: [gpio-controller.yaml, base.yaml]

properties:
  reg:
    required: true

  #clocks:
  #  required: true

  #resets:
  #  required: true

  "#gpio-cells":
    const: 2
  port:
    type: int
    required: true
    description: |
      The GPIO port number. GPIO port P0 has:

        port = <0>;

      And P1 has:

        port = <1>;
gpio-cells:
  - pin
  - flags
```

## dts/bindings/pinctrl/inplay,in6xxe-pinctrl.yaml
```yaml
# Copyright (c) 2023 InPlay Inc.
# SPDX-License-Identifier: Apache-2.0

description: |
    The INPLAY pin controller is a singleton node responsible for
    controlling pin function selection and pin properties. 



compatible: "inplay,in6xxe-pinctrl"


child-binding:
  description: |
    Each child node defines the configuration for a particular state.
  child-binding:
    description: |
      The grandchild nodes group pins that share the same pin configuration.
    properties:
      slew-rate:
        type: string
        default: "max-speed-2mhz"
        enum:
          - "max-speed-2mhz"
          - "max-speed-25mhz"
          - "max-speed-50mhz"
          - "max-speed-200mhz"
        description: |
          Set the maximum speed of a pin. This setting effectively limits the
          slew rate of the output signal. Defaults to "max-speed-2mhz", the SoC
          default.
```

## dts/bindings/serial/inplay,in6xxe-uart.yaml
```yaml
# Copyright (c) 2023 InPlay Inc.
# SPDX-License-Identifier: Apache-2.0

description: Inplay USART

compatible: "inplay,in6xxe-uart"

include: [uart-controller.yaml, reset-device.yaml, pinctrl-device.yaml]

properties:
  reg:
    required: true

  interrupts:
    required: true

      #resets:
      #required: true

      #clocks:
      #required: true
```

## modules/Kconfig.inplay
```kconfig
# Gecko SDK

# Copyright (c) 2017, Christian Taedcke
# SPDX-License-Identifier: Apache-2.0

config HAS_IN6XXE_HAL
	bool
	depends on SOC_FAMILY_INPLAY
```

## soc/arm/inplay/Kconfig
```kconfig
# SPDX-License-Identifier: Apache-2.0
#
# Copyright (c) 2023 InPlay <https://inplay-tech.com/>

config SOC_FAMILY_INPLAY
	bool

if SOC_FAMILY_INPLAY

config SOC_FAMILY
	string
	default "inplay"

source "soc/arm/inplay/*/Kconfig.soc"

endif # SOC_FAMILY_INPLAY
```

## soc/arm/inplay/Kconfig.defconfig
```kconfig
# SPDX-License-Identifier: Apache-2.0
#
# Copyright (c) 2023 InPlay <https://inplay-tech.com/>

if SOC_FAMILY_INPLAY

source "soc/arm/inplay/*/Kconfig.defconfig.series"
config SYS_CLOCK_HW_CYCLES_PER_SEC
	default 32000000 if !PM
	default 32000 if PM

config FLASH_BASE_ADDRESS
	hex
	default 0x0300000

config XIP
	bool
	default y
config FLASH_LOAD_OFFSET
	default 0x0
config SRAM_BASE_ADDRESS
	hex
	default 0x202000
config SRAM_SIZE
	default 120
config FLASH_SIZE
	default 512	
endif # SOC_FAMILY_INPLAY
```

## soc/arm/inplay/Kconfig.soc
```kconfig
# SPDX-License-Identifier: Apache-2.0
#
# Copyright (c) 2023 InPlay <https://inplay-tech.com/>

source "soc/arm/inplay/*/Kconfig.series"
```

## soc/arm/inplay/in6xxe/Kconfig.defconfig.in6xxe
```kconfig
# Copyright (c) 2023 InPlay Inc.
# SPDX-License-Identifier: Apache-2.0

if SOC_IN6XXE

config SOC
	default "IN6XXE"

config NUM_IRQS
	default 72

endif # SOC_IN6XXE
```

## soc/arm/inplay/in6xxe/Kconfig.defconfig.series
```kconfig
# Copyright (c) 2023 InPlay Inc.
# SPDX-License-Identifier: Apache-2.0

if SOC_SERIES_IN6XXE

source "soc/arm/inplay/in6xxe/Kconfig.defconfig.in6xxe*"

config SOC_SERIES
	default "in6xxe"

config CORTEX_M_SYSTICK
	default n if PM

config PM_DEVICE
	default y if PM

endif # SOC_SERIES_IN6XXE
```

## soc/arm/inplay/in6xxe/Kconfig.series
```kconfig
# Copyright (c) 2023 InPlay Inc.
# SPDX-License-Identifier: Apache-2.0

config SOC_SERIES_IN6XXE
	bool "InPlay 6XXE series MCU"
	select ARM
	select CPU_CORTEX_M4
	select CPU_HAS_ARM_MPU
	select SOC_FAMILY_INPLAY
	select HAS_SWO
	select CPU_CORTEX_M_HAS_SYSTICK
	select CPU_CORTEX_M_HAS_VTOR
	select HAS_IN6XXE_HAL
	help
	  Enable support for InPlay 6XXE MCU series
```

## soc/arm/inplay/in6xxe/Kconfig.soc
```kconfig
# Copyright (c) 2023 InPlay Inc.
# SPDX-License-Identifier: Apache-2.0

if SOC_SERIES_IN6XXE

choice
	prompt "InPlay 6XXE Selection"
	depends on SOC_SERIES_IN6XXE

config SOC_IN6XXE
	bool "IN6XXE"


endchoice


endif # SOC_SERIES_IN6XXE
```
